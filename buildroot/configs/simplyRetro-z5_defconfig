## buildroot/configs/simplyRetro-z5_defconfig
```kconfig
BR2_arm=y
BR2_arm1176jzf_s=y
BR2_CCACHE=y
BR2_OPTIMIZE_FAST=y
BR2_TOOLCHAIN_BUILDROOT_GLIBC=y
BR2_PACKAGE_HOST_LINUX_HEADERS_CUSTOM_4_19=y
BR2_TOOLCHAIN_BUILDROOT_CXX=y
BR2_TARGET_GENERIC_HOSTNAME="simplyretro"
BR2_TARGET_GENERIC_ISSUE="Welcome to simplyRetro"
BR2_ROOTFS_DEVICE_CREATION_DYNAMIC_EUDEV=y
BR2_TARGET_GENERIC_ROOT_PASSWD="simplyretro"
BR2_TARGET_TZ_INFO=y
BR2_ROOTFS_OVERLAY="board/simplyRetro/z5/fsoverlay"
BR2_ROOTFS_POST_BUILD_SCRIPT="board/simplyRetro/z5/post-build.sh"
BR2_ROOTFS_POST_IMAGE_SCRIPT="board/simplyRetro/z5/post-image.sh"
BR2_LINUX_KERNEL=y
BR2_LINUX_KERNEL_CUSTOM_TARBALL=y
BR2_LINUX_KERNEL_CUSTOM_TARBALL_LOCATION="$(call github,raspberrypi,linux,5eeff139ea9135db6e01a58ef613338f1d0899d8)/linux-5eeff139ea9135db6e01a58ef613338f1d0899d8.tar.gz"
BR2_LINUX_KERNEL_DEFCONFIG="bcmrpi"
BR2_LINUX_KERNEL_DTS_SUPPORT=y
BR2_LINUX_KERNEL_INTREE_DTS_NAME="bcm2708-rpi-0-w"
BR2_LINUX_KERNEL_DTB_OVERLAY_SUPPORT=y
BR2_LINUX_KERNEL_NEEDS_HOST_OPENSSL=y
BR2_PACKAGE_RETROARCH=y
BR2_PACKAGE_RETROARCH_TARGET_RPI0=y
BR2_PACKAGE_LIBRETRO_GAMBATTE=y
BR2_PACKAGE_LIBRETRO_SNES9X2002=y
BR2_PACKAGE_LIBRETRO_QUICKNES=y
BR2_PACKAGE_LIBRETRO_BEETLE_NGP=y
BR2_PACKAGE_LIBRETRO_PICODRIVE=y
BR2_PACKAGE_EMULATION_STATION=y
BR2_PACKAGE_RETROGAME=y
BR2_PACKAGE_E2FSPROGS=y
BR2_PACKAGE_E2FSPROGS_RESIZE2FS=y
BR2_PACKAGE_FBV=y
BR2_PACKAGE_SDL2=y
BR2_PACKAGE_SDL2_OPENGLES=y
BR2_PACKAGE_RPI_FIRMWARE=y
BR2_PACKAGE_RPI_WIFI_FIRMWARE=y
BR2_PACKAGE_RPI_USERLAND=y
BR2_PACKAGE_ALSA_LIB=y
BR2_PACKAGE_WIRINGPI=y
BR2_PACKAGE_BOOST=y
BR2_PACKAGE_BOOST_THREAD=y
BR2_PACKAGE_EIGEN=y
BR2_PACKAGE_VSFTPD=y
BR2_PACKAGE_WPA_SUPPLICANT=y
BR2_PACKAGE_NANO=y
BR2_TARGET_ROOTFS_EXT2=y
BR2_TARGET_ROOTFS_EXT2_4=y
BR2_TARGET_ROOTFS_EXT2_SIZE="180M"
BR2_PACKAGE_HOST_DOSFSTOOLS=y
BR2_PACKAGE_HOST_GENIMAGE=y
BR2_PACKAGE_HOST_MTOOLS=y
```

## buildroot/package/emulation-station/Config.in
```kconfig
config BR2_PACKAGE_EMULATION_STATION
	bool "Emulationstation 2 (RetroPie)"
	depends on BR2_INSTALL_LIBSTDCPP
	depends on BR2_PACKAGE_SDL2
	depends on BR2_PACKAGE_ALSA_LIB
	depends on BR2_PACKAGE_BOOST
	select BR2_PACKAGE_FREEIMAGE
	select BR2_PACKAGE_FREETYPE
	select BR2_PACKAGE_DEJAVU
	select BR2_PACKAGE_RAPIDJSON
	select BR2_PACKAGE_LIBCURL
	select BR2_PACKAGE_VLC
	select BR2_PACKAGE_BOOST_LAYOUT_SYSTEM
	select BR2_PACKAGE_BOOST_DATE_TIME
	select BR2_PACKAGE_BOOST_FILESYSTEM
	help
	  A multi emulator frontend.

	  https://github.com/RetroPie/EmulationStation

comment "Emulationstation 2 (RetroPie) needs a toolchain w/ C++, ALSA, BOOST, GLES, SDL2"
	depends on !BR2_INSTALL_LIBSTDCPP || !BR2_PACKAGE_SDL2 ||\
		!BR2_PACKAGE_ALSA_LIB || !BR2_PACKAGE_BOOST
```

## buildroot/package/libretro-mame2003-plus/Config.in
```kconfig
config BR2_PACKAGE_LIBRETRO_MAME2003_PLUS
	bool "libretro-mame2003-plus"
	depends on BR2_PACKAGE_RETROARCH
	depends on BR2_INSTALL_LIBSTDCPP
	help
	  A libretro mame2003 core for ARM with added game support
	  plus many fixes and improvements.

	  http://www.libretro.com

comment "LIBRETRO_MAME2003_PLUS needs a toolchain w/ C++"
	depends on !BR2_INSTALL_LIBSTDCPP
```

## buildroot/package/libretro-picodrive/Config.in
```kconfig
config BR2_PACKAGE_LIBRETRO_PICODRIVE
	bool "libretro-picodrive"
	depends on BR2_PACKAGE_RETROARCH
	depends on BR2_INSTALL_LIBSTDCPP
	depends on BR2_PACKAGE_LIBPNG
	depends on BR2_PACKAGE_SDL2
	help
	  A libretro Megadrive SMS emulator core for ARM.

	  http://www.libretro.com

comment "LIBRETRO_PICODRIVE needs a toolchain w/ C++"
	depends on !BR2_INSTALL_LIBSTDCPP && !BR2_PACKAGE_LIBPNG
```

## buildroot/package/libretro-snes9x2002/Config.in
```kconfig
config BR2_PACKAGE_LIBRETRO_SNES9X2002
	bool "libretro-snes9x2010"
	depends on BR2_PACKAGE_RETROARCH
	depends on BR2_INSTALL_LIBSTDCPP
	help
	  A libretro SNES emulator core for ARM.

	  http://www.libretro.com

comment "LIBRETRO_SNES9X2010 needs a toolchain w/ C++ and RetroArch"
	depends on !BR2_INSTALL_LIBSTDCPP || !BR2_PACKAGE_RETROARCH
```

## buildroot/package/pngview/Config.in
```kconfig
config BR2_PACKAGE_PNGVIEW
	bool "pngview"
	depends on BR2_PACKAGE_LIBPNG
	depends on BR2_PACKAGE_RPI_USERLAND
	help
	  Utility to display a PNG image on the Raspberry Pi screen using the Dispmanx windowing system

	  https://github.com/AndrewFromMelbourne/raspidmx/tree/master/pngview

comment "PNG View needs LIBPNG and RPI Userland"
	depends on !BR2_PACKAGE_LIBPNG || !BR2_PACKAGE_RPI_USERLAND
```

## buildroot/package/retroPower/Config.in
```kconfig
config BR2_PACKAGE_RETROPOWER
	bool "retropower"
	depends on BR2_PACKAGE_WIRINGPI
	depends on BR2_PACKAGE_PNGVIEW
	depends on BR2_INSTALL_LIBSTDCPP
	help
	  Power Off and Battery Indicator for simplyRetro

comment "retroPower needs a toolchain w/ C++ and PNGView"
	depends on !BR2_INSTALL_LIBSTDCPP || !BR2_PACKAGE_PNGVIEW
```

## buildroot/package/retroarch/Config.in
```kconfig
config BR2_PACKAGE_RETROARCH
	bool "Retroarch"
	depends on (BR2_PACKAGE_HAS_LIBGLES || BR2_PACKAGE_HAS_LIBEGL || BR2_PACKAGE_HAS_LIBGL)
	help
	  A multi emulator frontend.

	  http://www.libretro.com

choice
	prompt "RetroArch Target"
	default BR2_PACKAGE_RETROARCH_TARGET_RPI2
	help
	  Select RetroArch target hardware

config BR2_PACKAGE_RETROARCH_TARGET_RPI0
	bool "rpi0"

config BR2_PACKAGE_RETROARCH_TARGET_RPI1
	bool "rpi1"

config BR2_PACKAGE_RETROARCH_TARGET_RPI2
	bool "rpi2"

config BR2_PACKAGE_RETROARCH_TARGET_RPI3
	bool "rpi3"
endchoice


comment "Retroarch depends on EGL or OpenGLES"
	depends on !(BR2_PACKAGE_HAS_LIBEGL || BR2_PACKAGE_HAS_LIBGLES || BR2_PACKAGE_HAS_LIBGL)
```

## buildroot/package/retrogame/Config.in
```kconfig
config BR2_PACKAGE_RETROGAME
	bool "Adafruit Retro Game"
	help
	  Raspberry Pi GPIO-to-virtual-keyboard utility for classic game emulators.

	  https://github.com/adafruit/Adafruit-Retrogame
```
